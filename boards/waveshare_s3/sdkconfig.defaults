## components/bsp_waveshare_s3/Kconfig
```kconfig
choice ESPD_BOARD
    config ESPD_BOARD_WAVESHARE_S3
        bool "Waveshare ESP32-S3-AUDIO"
        imply ESPD_USE_ADC
        imply ESPD_PD_USE_SDCARD
        imply ESPD_PD_USE_ANALOG0
        imply ESPD_PD_INCLUDEPATCH
        imply ESPD_SKIP_WIFI_WHEN_MAIN_PD_ON_DISK
        help
            Waveshare AI Smart Speaker / ESP32-S3-AUDIO-Board (ES8311 DAC,
            ES7210 mic). Select in menuconfig; **ESPD_BSP_COMPONENT_NAME** links
            the BSP automatically (see components/bsp_waveshare_s3/README.txt).

endchoice

config ESPD_BSP_COMPONENT_NAME
    default "bsp_waveshare_s3" if ESPD_BOARD_WAVESHARE_S3

menu "Board Support Package (Waveshare S3)"
    depends on ESPD_BOARD_WAVESHARE_S3

config BSP_WAVESHARE_ENABLE_MIC
    bool "Enable ES7210 microphone capture"
    default y if ESPD_USE_ADC
    default n
    help
        When enabled, bsp_audio_init() also brings up the ES7210 ADC for adc~ input.

config BSP_WAVESHARE_EXIO7_USB_ROUTE_LEVEL
    int "EXIO7 USB route level (Type-C D+/D- to SoC USB)"
    default 1
    range 0 1

config BSP_WAVESHARE_EXIO6_CAMERA_SEL_LEVEL
    int "EXIO6 camera select level on USB switch"
    default 0
    range 0 1

config BSP_WAVESHARE_PA_PORT1_MASK
    hex "TCA9555 port1 PA enable bit mask (EXIO8..15)"
    default 0x03

config BSP_WAVESHARE_PA_PORT1_ACTIVE_HIGH
    bool "PA port1 bits are active-high"
    default y

endmenu
```

## components/bsp_waveshare_s3/sdkconfig.defaults
```kconfig
# Waveshare ESP32-S3-AUDIO-Board defaults (merged when this BSP is selected).
# See components/bsp_waveshare_s3/ and boards/waveshare_s3/README.txt

CONFIG_ESPTOOLPY_FLASHSIZE_16MB=y

CONFIG_PARTITION_TABLE_CUSTOM=y
CONFIG_PARTITION_TABLE_CUSTOM_FILENAME="partitions_pd.csv"
CONFIG_PARTITION_TABLE_FILENAME="partitions_pd.csv"
CONFIG_PARTITION_TABLE_OFFSET=0x8000

CONFIG_SPIRAM=y
CONFIG_SPIRAM_MODE_OCT=y
CONFIG_SPIRAM_SPEED_80M=y
CONFIG_SPIRAM_BOOT_INIT=y
CONFIG_SPIRAM_USE_MALLOC=y

CONFIG_ESP_DEFAULT_CPU_FREQ_MHZ_240=y

CONFIG_ESP32S3_REV_MIN_2=y
CONFIG_ESP32S3_REV_MIN_FULL=2
CONFIG_ESP_REV_MIN_FULL=2

CONFIG_ESP_MAIN_TASK_STACK_SIZE=65536
CONFIG_PTHREAD_TASK_STACK_SIZE_DEFAULT=8192
CONFIG_PTHREAD_TASK_PRIO_DEFAULT=5
CONFIG_PTHREAD_TASK_CORE_DEFAULT=0

CONFIG_ESP_CONSOLE_UART_DEFAULT=y
CONFIG_ESP_CONSOLE_UART=y
CONFIG_ESP_CONSOLE_UART_NUM=0

CONFIG_COMPILER_OPTIMIZATION_PERF=y
CONFIG_COMPILER_OPTIMIZATION_ASSERTIONS_DISABLE=y
CONFIG_COMPILER_OPTIMIZATION_ASSERTION_LEVEL=0

CONFIG_LOG_DEFAULT_LEVEL_WARN=y
CONFIG_LOG_DEFAULT_LEVEL=2
CONFIG_LOG_MAXIMUM_LEVEL_INFO=y
CONFIG_LOG_MAXIMUM_LEVEL=3

CONFIG_LWIP_IPV6=y
CONFIG_MBEDTLS_TLS_CLIENT_ONLY=y

CONFIG_ESP_MAIN_TASK_AFFINITY_CPU1=y
CONFIG_ESP_MAIN_TASK_AFFINITY=0x1
CONFIG_ESP_WIFI_TASK_PINNED_TO_CORE_0=y
CONFIG_LWIP_TCPIP_TASK_AFFINITY_CPU0=y
CONFIG_LWIP_TCPIP_TASK_AFFINITY=0x0
CONFIG_ESP_TIMER_TASK_AFFINITY=0x0
CONFIG_ESP_TIMER_TASK_AFFINITY_CPU0=y

CONFIG_SPIRAM_TRY_ALLOCATE_WIFI_LWIP=y
CONFIG_SPIRAM_MALLOC_ALWAYSINTERNAL=0
CONFIG_SPIRAM_MALLOC_RESERVE_INTERNAL=65536
CONFIG_ESP_WIFI_STATIC_RX_BUFFER_NUM=8
CONFIG_ESP_WIFI_DYNAMIC_RX_BUFFER_NUM=16
CONFIG_ESP_WIFI_DYNAMIC_TX_BUFFER_NUM=16
CONFIG_LWIP_MAX_SOCKETS=8

CONFIG_CODEC_ES8311_SUPPORT=y
CONFIG_CODEC_ES7210_SUPPORT=y

CONFIG_FREERTOS_IN_IRAM=y
```

## components/espd_bsp_selector/Kconfig
```kconfig
choice ESPD_BOARD
    config ESPD_BOARD_WAVESHARE_S3
        bool "Waveshare ESP32-S3-AUDIO"
        select ESPD_USE_ADC
        select ESPD_PD_USE_SDCARD
        select ESPD_PD_USE_ANALOG0
        select ESPD_PD_USE_AOUT
        select ESPD_PD_INCLUDEPATCH
        select ESPD_SKIP_WIFI_WHEN_MAIN_PD_ON_DISK
        select SPIRAM
        select FREERTOS_IN_IRAM
        help
            Waveshare AI Smart Speaker / ESP32-S3-AUDIO-Board (ES8311 DAC,
            ES7210 mic). Hardware comes from esp-bsp via Component Manager
            (see components/espd_bsp_selector/idf_component.yml).

endchoice

choice ESPD_BOARD
    default ESPD_BOARD_WAVESHARE_S3 if IDF_TARGET_ESP32S3
endchoice

config WAVESHARE_ESP32_S3_AUDIO
    int
    default 1 if ESPD_BOARD_WAVESHARE_S3
    default 0

config PTHREAD_TASK_STACK_SIZE_DEFAULT
    default 8192 if ESPD_BOARD_WAVESHARE_S3

config ESP_MAIN_TASK_STACK_SIZE
    default 65536 if ESPD_BOARD_WAVESHARE_S3
```
